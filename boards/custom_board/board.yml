## boards/custom_board/board.yml
```yaml
board:
  name: custom_board
  full_name: Custom Board
  vendor: myself
  socs:
    - name: stm32f401xe
```

## boards/scratch_board/board.yml
```yaml
board:
  name: scratch_board
  full_name: Scratch Board
  vendor: myself
  socs:
    - name: stm32f401xe
```

## our-driver-module/drivers/our_driver/Kconfig
```kconfig
config OUR_DRIVER
    bool "Our Sensor Driver"
    default y
    depends on DT_HAS_OUR_DRIVER_ENABLED

config OUR_DRIVER_SHELL
    bool "Our Sensor Driver Shell"
    default y
    depends on OUR_DRIVER
    select SHELL
```

## our-driver-module/dts/bindings/our,driver.yaml
```yaml
description: Our Sensor Driver for Homework 6.1
compatible: "our,driver"
include: base.yaml
properties:
  led-gpios:
    type: phandle-array
    required: true
```

## twister-out/native_sim_native/host/homework.unit.ring_buf/Kconfig/arch/Kconfig
```kconfig
# Load Zephyr Arch Kconfig descriptions.
osource "/home/rogerio/Projetos/iomico-course/deps/zephyr/arch/rx/Kconfig"
osource "/home/rogerio/Projetos/iomico-course/deps/zephyr/arch/x86/Kconfig"
osource "/home/rogerio/Projetos/iomico-course/deps/zephyr/arch/xtensa/Kconfig"
osource "/home/rogerio/Projetos/iomico-course/deps/zephyr/arch/sparc/Kconfig"
osource "/home/rogerio/Projetos/iomico-course/deps/zephyr/arch/riscv/Kconfig"
osource "/home/rogerio/Projetos/iomico-course/deps/zephyr/arch/posix/Kconfig"
osource "/home/rogerio/Projetos/iomico-course/deps/zephyr/arch/mips/Kconfig"
osource "/home/rogerio/Projetos/iomico-course/deps/zephyr/arch/arm64/Kconfig"
osource "/home/rogerio/Projetos/iomico-course/deps/zephyr/arch/arm/Kconfig"
osource "/home/rogerio/Projetos/iomico-course/deps/zephyr/arch/arc/Kconfig"
```

## twister-out/native_sim_native/host/homework.unit.ring_buf/Kconfig/boards/Kconfig
```kconfig
# Load Zephyr board Kconfig descriptions.
osource "/home/rogerio/Projetos/iomico-course/deps/zephyr/boards/native/native_sim/Kconfig"
```

## twister-out/native_sim_native/host/homework.unit.ring_buf/Kconfig/boards/Kconfig.defconfig
```kconfig
# Load Zephyr board defconfig descriptions.
osource "/home/rogerio/Projetos/iomico-course/deps/zephyr/boards/native/native_sim/Kconfig.defconfig"
```

## twister-out/native_sim_native/host/homework.unit.ring_buf/Kconfig/boards/Kconfig.native_sim
```kconfig
# Load board Kconfig descriptions.
osource "/home/rogerio/Projetos/iomico-course/deps/zephyr/boards/native/native_sim/Kconfig.native_sim"
```

## twister-out/native_sim_native/host/homework.unit.ring_buf/Kconfig/boards/Kconfig.sysbuild
```kconfig
# Load Sysbuild board Kconfig descriptions.
osource "/home/rogerio/Projetos/iomico-course/deps/zephyr/boards/native/native_sim/Kconfig.sysbuild"
```

## twister-out/native_sim_native/host/homework.unit.ring_buf/Kconfig/soc/Kconfig
```kconfig
# Load Zephyr SoC Kconfig descriptions.
osource "/home/rogerio/Projetos/iomico-course/deps/zephyr/soc/xlnx/zynqmp/Kconfig"
osource "/home/rogerio/Projetos/iomico-course/deps/zephyr/soc/xlnx/zynq7000/Kconfig"
osource "/home/rogerio/Projetos/iomico-course/deps/zephyr/soc/xlnx/versalnet/Kconfig"
osource "/home/rogerio/Projetos/iomico-course/deps/zephyr/soc/xlnx/versal2/Kconfig"
osource "/home/rogerio/Projetos/iomico-course/deps/zephyr/soc/xen/Kconfig"
osource "/home/rogerio/Projetos/iomico-course/deps/zephyr/soc/wch/ch32v/Kconfig"
osource "/home/rogerio/Projetos/iomico-course/deps/zephyr/soc/ti/simplelink/Kconfig"
osource "/home/rogerio/Projetos/iomico-course/deps/zephyr/soc/ti/mspm0/Kconfig"
osource "/home/rogerio/Projetos/iomico-course/deps/zephyr/soc/ti/lm3s6965/Kconfig"
osource "/home/rogerio/Projetos/iomico-course/deps/zephyr/soc/ti/k3/Kconfig"
osource "/home/rogerio/Projetos/iomico-course/deps/zephyr/soc/telink/tlsr/Kconfig"
osource "/home/rogerio/Projetos/iomico-course/deps/zephyr/soc/starfive/jh71xx/Kconfig"
osource "/home/rogerio/Projetos/iomico-course/deps/zephyr/soc/st/stm32/Kconfig"
osource "/home/rogerio/Projetos/iomico-course/deps/zephyr/soc/snps/qemu_arc/Kconfig"
osource "/home/rogerio/Projetos/iomico-course/deps/zephyr/soc/snps/nsim/arc_v/Kconfig"
osource "/home/rogerio/Projetos/iomico-course/deps/zephyr/soc/snps/nsim/arc_classic/Kconfig"
osource "/home/rogerio/Projetos/iomico-course/deps/zephyr/soc/snps/hsdk4xd/Kconfig"
osource "/home/rogerio/Projetos/iomico-course/deps/zephyr/soc/snps/hsdk/Kconfig"
osource "/home/rogerio/Projetos/iomico-course/deps/zephyr/soc/snps/emsk/Kconfig"
osource "/home/rogerio/Projetos/iomico-course/deps/zephyr/soc/snps/emsdp/Kconfig"
osource "/home/rogerio/Projetos/iomico-course/deps/zephyr/soc/snps/arc_iot/Kconfig"
osource "/home/rogerio/Projetos/iomico-course/deps/zephyr/soc/silabs/Kconfig"
osource "/home/rogerio/Projetos/iomico-course/deps/zephyr/soc/sifive/sifive_freedom/Kconfig"
osource "/home/rogerio/Projetos/iomico-course/deps/zephyr/soc/sensry/Kconfig"
osource "/home/rogerio/Projetos/iomico-course/deps/zephyr/soc/rockchip/Kconfig"
osource "/home/rogerio/Projetos/iomico-course/deps/zephyr/soc/renode/riscv_virtual/Kconfig"
osource "/home/rogerio/Projetos/iomico-course/deps/zephyr/soc/renode/cortex_r8_virtual/Kconfig"
osource "/home/rogerio/Projetos/iomico-course/deps/zephyr/soc/renesas/smartbond/Kconfig"
osource "/home/rogerio/Projetos/iomico-course/deps/zephyr/soc/renesas/rz/Kconfig"
osource "/home/rogerio/Projetos/iomico-course/deps/zephyr/soc/renesas/rx/Kconfig"
osource "/home/rogerio/Projetos/iomico-course/deps/zephyr/soc/renesas/rcar/Kconfig"
osource "/home/rogerio/Projetos/iomico-course/deps/zephyr/soc/renesas/ra/Kconfig"
osource "/home/rogerio/Projetos/iomico-course/deps/zephyr/soc/realtek/ec/Kconfig"
osource "/home/rogerio/Projetos/iomico-course/deps/zephyr/soc/raspberrypi/rpi_pico/Kconfig"
osource "/home/rogerio/Projetos/iomico-course/deps/zephyr/soc/quicklogic/eos_s3/Kconfig"
osource "/home/rogerio/Projetos/iomico-course/deps/zephyr/soc/qemu/virt_riscv/Kconfig"
osource "/home/rogerio/Projetos/iomico-course/deps/zephyr/soc/qemu/malta/Kconfig"
osource "/home/rogerio/Projetos/iomico-course/deps/zephyr/soc/openisa/rv32m1/Kconfig"
osource "/home/rogerio/Projetos/iomico-course/deps/zephyr/soc/openhwgroup/cva6/Kconfig"
osource "/home/rogerio/Projetos/iomico-course/deps/zephyr/soc/oct/osd32mp15x/Kconfig"
osource "/home/rogerio/Projetos/iomico-course/deps/zephyr/soc/nxp/s32/Kconfig"
osource "/home/rogerio/Projetos/iomico-course/deps/zephyr/soc/nxp/rw/Kconfig"
osource "/home/rogerio/Projetos/iomico-course/deps/zephyr/soc/nxp/mcx/Kconfig"
osource "/home/rogerio/Projetos/iomico-course/deps/zephyr/soc/nxp/lpc/Kconfig"
osource "/home/rogerio/Projetos/iomico-course/deps/zephyr/soc/nxp/layerscape/Kconfig"
osource "/home/rogerio/Projetos/iomico-course/deps/zephyr/soc/nxp/kinetis/Kconfig"
osource "/home/rogerio/Projetos/iomico-course/deps/zephyr/soc/nxp/imxrt/Kconfig"
osource "/home/rogerio/Projetos/iomico-course/deps/zephyr/soc/nxp/imx/Kconfig"
osource "/home/rogerio/Projetos/iomico-course/deps/zephyr/soc/nuvoton/numicro/Kconfig"
osource "/home/rogerio/Projetos/iomico-course/deps/zephyr/soc/nuvoton/numaker/Kconfig"
osource "/home/rogerio/Projetos/iomico-course/deps/zephyr/soc/nuvoton/npcx/Kconfig"
osource "/home/rogerio/Projetos/iomico-course/deps/zephyr/soc/nuvoton/npcm/Kconfig"
osource "/home/rogerio/Projetos/iomico-course/deps/zephyr/soc/nordic/Kconfig"
osource "/home/rogerio/Projetos/iomico-course/deps/zephyr/soc/neorv32/Kconfig"
osource "/home/rogerio/Projetos/iomico-course/deps/zephyr/soc/native/inf_clock/Kconfig"
osource "/home/rogerio/Projetos/iomico-course/deps/zephyr/soc/microchip/sam/Kconfig"
osource "/home/rogerio/Projetos/iomico-course/deps/zephyr/soc/microchip/miv/Kconfig"
osource "/home/rogerio/Projetos/iomico-course/deps/zephyr/soc/microchip/mec/Kconfig"
osource "/home/rogerio/Projetos/iomico-course/deps/zephyr/soc/mediatek/mt8xxx/Kconfig"
osource "/home/rogerio/Projetos/iomico-course/deps/zephyr/soc/lowrisc/opentitan/Kconfig"
osource "/home/rogerio/Projetos/iomico-course/deps/zephyr/soc/litex/litex_vexriscv/Kconfig"
osource "/home/rogerio/Projetos/iomico-course/deps/zephyr/soc/ite/ec/Kconfig"
osource "/home/rogerio/Projetos/iomico-course/deps/zephyr/soc/intel/raptor_lake/Kconfig"
osource "/home/rogerio/Projetos/iomico-course/deps/zephyr/soc/intel/lakemont/Kconfig"
osource "/home/rogerio/Projetos/iomico-course/deps/zephyr/soc/intel/intel_socfpga_std/Kconfig"
osource "/home/rogerio/Projetos/iomico-course/deps/zephyr/soc/intel/intel_socfpga/Kconfig"
osource "/home/rogerio/Projetos/iomico-course/deps/zephyr/soc/intel/intel_niosv/Kconfig"
osource "/home/rogerio/Projetos/iomico-course/deps/zephyr/soc/intel/intel_ish/Kconfig"
osource "/home/rogerio/Projetos/iomico-course/deps/zephyr/soc/intel/intel_adsp/Kconfig"
osource "/home/rogerio/Projetos/iomico-course/deps/zephyr/soc/intel/elkhart_lake/Kconfig"
osource "/home/rogerio/Projetos/iomico-course/deps/zephyr/soc/intel/atom/Kconfig"
osource "/home/rogerio/Projetos/iomico-course/deps/zephyr/soc/intel/apollo_lake/Kconfig"
osource "/home/rogerio/Projetos/iomico-course/deps/zephyr/soc/intel/alder_lake/Kconfig"
osource "/home/rogerio/Projetos/iomico-course/deps/zephyr/soc/infineon/cat3/Kconfig"
osource "/home/rogerio/Projetos/iomico-course/deps/zephyr/soc/infineon/cat1c/Kconfig"
osource "/home/rogerio/Projetos/iomico-course/deps/zephyr/soc/infineon/cat1b/Kconfig"
osource "/home/rogerio/Projetos/iomico-course/deps/zephyr/soc/infineon/cat1a/Kconfig"
osource "/home/rogerio/Projetos/iomico-course/deps/zephyr/soc/gd/gd32/Kconfig"
osource "/home/rogerio/Projetos/iomico-course/deps/zephyr/soc/gaisler/leon3/Kconfig"
osource "/home/rogerio/Projetos/iomico-course/deps/zephyr/soc/gaisler/gr716a/Kconfig"
osource "/home/rogerio/Projetos/iomico-course/deps/zephyr/soc/espressif/Kconfig"
osource "/home/rogerio/Projetos/iomico-course/deps/zephyr/soc/ene/kb1200/Kconfig"
osource "/home/rogerio/Projetos/iomico-course/deps/zephyr/soc/ene/kb106x/Kconfig"
osource "/home/rogerio/Projetos/iomico-course/deps/zephyr/soc/efinix/sapphire/Kconfig"
osource "/home/rogerio/Projetos/iomico-course/deps/zephyr/soc/cdns/xtensa_sample_controller/Kconfig"
osource "/home/rogerio/Projetos/iomico-course/deps/zephyr/soc/cdns/sample_controller32/Kconfig"
osource "/home/rogerio/Projetos/iomico-course/deps/zephyr/soc/cdns/dc233c/Kconfig"
osource "/home/rogerio/Projetos/iomico-course/deps/zephyr/soc/brcm/bcmvk/Kconfig"
osource "/home/rogerio/Projetos/iomico-course/deps/zephyr/soc/brcm/bcm2712/Kconfig"
osource "/home/rogerio/Projetos/iomico-course/deps/zephyr/soc/brcm/bcm2711/Kconfig"
osource "/home/rogerio/Projetos/iomico-course/deps/zephyr/soc/bflb/Kconfig"
osource "/home/rogerio/Projetos/iomico-course/deps/zephyr/soc/atmel/sam0/Kconfig"
osource "/home/rogerio/Projetos/iomico-course/deps/zephyr/soc/atmel/sam/Kconfig"
osource "/home/rogerio/Projetos/iomico-course/deps/zephyr/soc/aspeed/Kconfig"
osource "/home/rogerio/Projetos/iomico-course/deps/zephyr/soc/arm/Kconfig"
osource "/home/rogerio/Projetos/iomico-course/deps/zephyr/soc/arm/beetle/Kconfig"
osource "/home/rogerio/Projetos/iomico-course/deps/zephyr/soc/antmicro/myra/Kconfig"
osource "/home/rogerio/Projetos/iomico-course/deps/zephyr/soc/andestech/Kconfig"
osource "/home/rogerio/Projetos/iomico-course/deps/zephyr/soc/amd/acp_6_0/Kconfig"
osource "/home/rogerio/Projetos/iomico-course/deps/zephyr/soc/ambiq/Kconfig"
osource "/home/rogerio/Projetos/iomico-course/deps/zephyr/soc/aesc/Kconfig"
osource "/home/rogerio/Projetos/iomico-course/deps/zephyr/soc/adi/max32/Kconfig"
```
