## CMakeLists.txt
```
cmake_minimum_required(VERSION 3.20.0)

list(APPEND BOARD_ROOT ${CMAKE_CURRENT_SOURCE_DIR}/..)
list(APPEND ZEPHYR_EXTRA_MODULES ${CMAKE_CURRENT_SOURCE_DIR}/../our-driver-module)

find_package(Zephyr REQUIRED HINTS $ENV{ZEPHYR_BASE})
project(my_zephyr_app)

target_sources(app PRIVATE src/main.c)
```

## Kconfig
```
config APP_HEARTBEAT_PERIOD_MS
    int "Hearbeat Period"
    default 500
    range 100 2000

menuconfig LED_SUBSYSTEM
    bool "LED Subsystem"
    default y

if LED_SUBSYSTEM
choice
    prompt "LED blink sleep time"
    default BLINK_SLEEP_1000MS

config BLINK_SLEEP_250MS
    bool "250ms (fast)"

config BLINK_SLEEP_1000MS
    bool "1s (medium)"

config BLINK_SLEEP_2000MS
    bool "2s (slow)"
endchoice

config BLINK_SLEEP_TIME_MS
    int
    default 250  if BLINK_SLEEP_250MS
    default 1000 if BLINK_SLEEP_1000MS
    default 2000 if BLINK_SLEEP_2000MS
    default 0

menuconfig ADVANCED_LED_SETTINGS
    bool "Advanced LED settings"
    default n

if ADVANCED_LED_SETTINGS

config LED_BRIGHTNESS
    int "LED brightness (0-100)"
    range 0 100
    default 100

config LED_FADE_DURATION
    int "LED fade duration (ms)"
    default 500

menu "Expert settings"

config LED_DEBUGGING
    bool "Enable LED debugging"
    default n

config CUSTOM_BLINK_PATTERN
    bool "Custom blink pattern"
    default n

endmenu # Expert_settings

endif # ADVANCED_LED_SETTINGS

endif # LED_SUBSYSTEM

source "Kconfig.zephyr"
rsource "../our-driver-module/drivers/our_driver/Kconfig"
```

## prj.conf
```kconfig
CONFIG_GPIO=y
CONFIG_LOG=y
CONFIG_OUR_DRIVER=y
CONFIG_OUR_DRIVER_SHELL=y
```

## app.overlay
```dts
/ {
    aliases {
        app-led = &green_led_2;
    };

    our_driver0: our_driver {
        compatible = "our,driver";
        led-gpios = < &gpioa 0x5 0x0>;
        status = "okay";
    };
};
```

## src/main.c
```c
#include <zephyr/kernel.h>
#include <zephyr/logging/log.h>
#include <zephyr/drivers/sensor.h>
#include "our_driver.h"

LOG_MODULE_REGISTER(main, LOG_LEVEL_INF);

int main(void)
{
    const struct device *dev = DEVICE_DT_GET_ANY(our_driver);

    if (!device_is_ready(dev)) {
        return -ENODEV;
    }

    while (1) {
        //Turn on
        sensor_sample_fetch(dev);
        LOG_INF("Driver LED state: ON");
        k_msleep(CONFIG_APP_HEARTBEAT_PERIOD_MS);
        sensor_channel_get(dev, SENSOR_CHAN_ALL, NULL);
        LOG_INF("Driver LED state: OFF");
        k_msleep(CONFIG_APP_HEARTBEAT_PERIOD_MS);
        LOG_INF("LED was turned on: %u time(s)", our_driver_get_count(dev) );
    }
    return 0;
}
```

## src/main.cpp
```c
#include <zephyr/kernel.h>
#include <zephyr/logging/log.h>
#include <zephyr/drivers/sensor.h>

LOG_MODULE_REGISTER(main, LOG_LEVEL_INF);

int main(void)
{
    const struct device *dev = DEVICE_DT_GET_ANY(our_driver);

    if (!device_is_ready(dev)) {
        return -ENODEV;
    }

    while (1) {
        //Turn on
        sensor_sample_fetch(dev);
        LOG_INF("Driver LED state: ON");
        k_msleep(CONFIG_APP_HEARTBEAT_PERIOD_MS);
        sensor_channel_get(dev, SENSOR_CHAN_ALL, NULL);
        LOG_INF("Driver LED state: OFF");
        k_msleep(CONFIG_APP_HEARTBEAT_PERIOD_MS);        
    }
    return 0;
}
```
